## Kconfig
```kconfig
config SENSORS_TMF8806
	tristate "ams-OSRAM TMF8806 TOF"
    	depends on I2C
	default n
 	help
	  If you say yes here you get support for the  tmf8806 sensor.
​
	  This driver can also be built as a module.  If so, the module
	  will be called tmf8806.ko.
```
